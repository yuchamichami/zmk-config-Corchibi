## Kconfig
```kconfig
if ZMK_POINTING

config ZMK_INPUT_PROCESSOR_VERTICAL_SCROLL
    bool "Vertical-only scroll input processor"
    default y
    depends on DT_HAS_ZMK_INPUT_PROCESSOR_VERTICAL_SCROLL_ENABLED

endif
```

## boards/shields/Corchibi/Kconfig.defconfig
```kconfig
if SHIELD_CORCHIBI_R

config ZMK_KEYBOARD_NAME
    default "Corchibi"

config ZMK_SPLIT
    default y

config ZMK_SPLIT_ROLE_CENTRAL
    default y

endif

if SHIELD_CORCHIBI_L

config ZMK_KEYBOARD_NAME
    default "Corchibi"

config ZMK_SPLIT
    default y

endif
```

## boards/shields/Corchibi/Kconfig.shield
```kconfig
config SHIELD_CORCHIBI_R
    def_bool $(shields_list_contains,Corchibi_R)

config SHIELD_CORCHIBI_L
    def_bool $(shields_list_contains,Corchibi_L)
```

## config/west.yml
```yaml
manifest:
  remotes:
    - name: zmkfirmware
      url-base: https://github.com/zmkfirmware
    - name: yuchamichami
      url-base: https://github.com/yuchamichami
    - name: badjeff
      url-base: https://github.com/badjeff
    - name: nuovotaka
      url-base: https://github.com/nuovotaka
    - name: cormoran
      url-base: https://github.com/cormoran
  projects:
    - name: zmk-driver-pat9125
      remote: yuchamichami
      revision: main
    - name: zmk-input-processor-report-rate-limit
      remote: badjeff
      revision: f43f37aae7aaa7bf0ec4d432683b873a7e3a8efa
    - name: zmk-behavior-insomnia
      remote: badjeff
      revision: main
    - name: zmk-pointing-acceleration-alpha
      remote: nuovotaka
      revision: main
    - name: zmk
      remote: cormoran
      revision: v0.3-branch+dya
      import: app/west.yml
    - name: zmk-module-ble-management
      remote: cormoran
      revision: main
    - name: zmk-module-battery-history
      remote: cormoran
      revision: main
    - name: zmk-module-runtime-input-processor
      remote: cormoran
      revision: main
  self:
    path: config
```

## dts/bindings/input_processors/zmk,input-processor-vertical-scroll.yaml
```yaml
# Copyright (c) 2026
# SPDX-License-Identifier: MIT

description: Input processor that converts relative X/Y motion into vertical wheel events, or horizontal wheel events while Shift is held

compatible: "zmk,input-processor-vertical-scroll"

include: ip_zero_param.yaml

properties:
  type:
    type: int
```
